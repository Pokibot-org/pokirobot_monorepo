## CMakeLists.txt
```
cmake_minimum_required(VERSION 3.20.0)

find_package(Zephyr REQUIRED HINTS $ENV{ZEPHYR_BASE})
project(test_servomotor)

target_include_directories(app PRIVATE src)

file(GLOB_RECURSE APP_SOURCES src/*.c)

target_sources(app PRIVATE ${APP_SOURCES})
```

## prj.conf
```kconfig
# SERIAL
CONFIG_SERIAL=y
CONFIG_LOG=y
CONFIG_UART_INTERRUPT_DRIVEN=y

CONFIG_LOG_MODE_DEFERRED=y
CONFIG_LOG_BACKEND_SHOW_COLOR=y
CONFIG_LOG_DEFAULT_LEVEL=3

CONFIG_SERVOMOTOR=y

CONFIG_CBPRINTF_COMPLETE=y
CONFIG_CBPRINTF_FP_SUPPORT=y
```

## boards/nucleo_wl55jc.overlay
```dts
/ {
    servomotor0:mg996r0 {
    	status = "okay";
    	compatible = "pokibot,pwm-servomotor";
        pwms = <&pwm2 2 PWM_MSEC(20) PWM_POLARITY_NORMAL>;
        min-pulse = <PWM_USEC(500)>;
        max-pulse = <PWM_USEC(2500)>;
        min-angle = <0>;
        max-angle = <180>;
    };
};

&timers2 {
	status = "okay";

	pwm2: pwm {
		status = "okay";
		pinctrl-0 = <&tim2_ch2_pb3>;
		pinctrl-names = "default";
	};
};
```

## src/main.c
```c
#include <zephyr/kernel.h>
#include <zephyr/logging/log.h>
#include <pokibot/drivers/servomotor.h>
#include <pokibot/poktypes.h>

LOG_MODULE_REGISTER(main);

const struct device *servomotor0 = DEVICE_DT_GET(DT_NODELABEL(servomotor0));


int main(void)
{
    while (1) {
        servomotor_set_angle(servomotor0, 0);
        k_sleep(K_SECONDS(1));
        servomotor_set_angle(servomotor0, M_PI);
        k_sleep(K_SECONDS(1));
    }
    return 0;
}
```
