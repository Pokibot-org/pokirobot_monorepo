## boards/pokibot/interco_weact_h743/Kconfig.defconfig
```kconfig
# WeAct Studio MiniSTM32H7 board configuration pokibot interco flavored

# Copyright (c) Charles Dias <charlesdias.cd@outlook.com>
# SPDX-License-Identifier: Apache-2.0

if BOARD_INTERCO_WEACT_H743

if DISPLAY

config INPUT
	default y

if LVGL

configdefault LV_COLOR_16_SWAP
	default y

config LV_Z_BITS_PER_PIXEL
	default 16

endif # LVGL

endif # DISPLAY

endif # BOARD_INTERCO_WEACT_H743
```

## boards/pokibot/interco_weact_h743/Kconfig.interco_weact_h743
```kconfig
# Copyright (c) 2024 Charles Dias <charlesdias.cd@outlook.com>
# SPDX-License-Identifier: Apache-2.0

config BOARD_INTERCO_WEACT_H743
	select SOC_STM32H743XX
```

## boards/pokibot/interco_weact_h743/board.yml
```yaml
board:
    name: interco_weact_h743
    full_name: interco_weact_h743 Core Board
    vendor: pokibot
    socs:
        - name: stm32h743xx
```

## boards/pokibot/pokimotor/Kconfig.defconfig
```kconfig
# SPDX-License-Identifier: Apache-2.0

if BOARD_POKIMOTOR

config SPI_STM32_INTERRUPT
	default y
	depends on SPI

endif
```

## boards/pokibot/pokimotor/board.yml
```yaml
board:
  name: pokimotor
  full_name: Pokimotor
  vendor: pokibot
  socs:
    - name: stm32g474xx
```

## brain_app/src/nav/Kconfig
```kconfig
module = NAV
module-str = nav
source "subsys/logging/Kconfig.template.log_config"
```

## drivers/Kconfig
```kconfig
menu "Pokibot libraries"

rsource "lidar/Kconfig"
rsource "pokmac/Kconfig"
rsource "pokstepper/Kconfig"
rsource "uart_bus/Kconfig"

endmenu
```

## drivers/lidar/Kconfig
```kconfig
config LIDAR
	bool "Enable lidar drivers"
	help
	  Enable lidar drivers

if LIDAR

config LIDAR_FHL_LD19
    bool "Enable fhl-ld19 drivers"
    default y
   	depends on DT_HAS_ZEPHYR_FHL_LD19_ENABLED

config LIDAR_MSMLIDAR
    bool "Enable msmlidar drivers"
    default y
   	depends on DT_HAS_POKIBOT_MSMLIDAR_ENABLED
    select JSON_LIBRARY

endif
```

## drivers/pokmac/Kconfig
```kconfig
config POKMAC
    bool "Enable pokmac drivers"
        default y
    depends on DT_HAS_POKIBOT_POKMAC_ENABLED
    select UART_INTERRUPT_DRIVEN
    select CRC
    select EVENTS
        help
        Enable pokmac drivers

config POKMAC_INIT_PRIORITY
    int "Pokmac init priority"
	default 60

config POKMAC_BUFFER_SIZE
    int "Pokmac buffer size"
    default 128

config POKMAC_ACK_TIMEOUT_MS
    int "Pokmac ACK timeout"
    default 10

module = POKMAC
module-str = pokmac
source "subsys/logging/Kconfig.template.log_config"
```

## drivers/pokstepper/Kconfig
```kconfig
menuconfig POKSTEPPER
	bool "Stepper Controller pokibot flavored"
	help
	  Enable stepper controller pokibot flavored

if POKSTEPPER

module = POKSTEPPER
module-str = pokstepper
source "subsys/logging/Kconfig.template.log_config"

config POKSTEPPER_INIT_PRIORITY
	int "Stepper Motor Controller init priority"
	default 90
	help
	  Stepper motor controller initialization priority.

config POKSTEPPER_POKIBOT_EMPTY_POKSTEPPER
	bool "Activate empty pokibot flavored stepper driver"
	depends on DT_HAS_POKIBOT_EMPTY_POKSTEPPER_ENABLED
	default y
	help
	  Empty stepper driver.

comment "Stepper Drivers pokibot flavored"

# zephyr-keep-sorted-start
rsource "adi_tmc/Kconfig"
# zephyr-keep-sorted-stop

endif
```

## drivers/pokstepper/adi_tmc/Kconfig
```kconfig
menuconfig POKSTEPPER_ADI_TMC
	bool "Trinamic pokibot flavored Stepper Controller"
	depends on POKSTEPPER
	default y
	help
	  Enable trinamic pokstepper controller


if POKSTEPPER_ADI_TMC

config POKSTEPPER_ADI_TMC_UART
	bool "Use Trinamic Stepper Controller with UART"
	depends on POKSTEPPER_ADI_TMC
	select UART
	help
	  A Trinamic Stepper Controller with UART is enabled

comment "Trinamic Stepper Drivers"

rsource "Kconfig.tmc22xx_pokibot"

endif # STEPPER_ADI_TMC
```

## drivers/pokstepper/adi_tmc/Kconfig.tmc22xx_pokibot
```kconfig
config POKSTEPPER_ADI_TMC2209_POKIBOT
	bool "Activate trinamic tmc2209 pokibot flavored stepper driver"
	depends on DT_HAS_ADI_TMC2209_POKIBOT_ENABLED
	select POKSTEPPER_ADI_TMC_UART
	select COUNTER
	select EVENTS
	default y
	help
	  Stepper driver for TMC2209.
```

## drivers/servomotor/Kconfig
```kconfig
menuconfig SERVOMOTOR
    bool "Enable servomotor drivers"
        default n

if SERVOMOTOR

config SERVOMOTOR_INIT_PRIORITY
    int "Servomotor init priority"
	default 60

config PWM_SERVOMOTOR
    bool "Enable pwm servomotor drivers"
        default y
    depends on DT_HAS_POKIBOT_PWM_SERVOMOTOR_ENABLED
    select PWM

module = SERVOMOTOR
module-str = servomotor
source "subsys/logging/Kconfig.template.log_config"

endif
```

## drivers/shared_uart/Kconfig
```kconfig
menuconfig SHARED_UART
	bool "Shared UART line support"
	default y
	depends on DT_HAS_ZEPHYR_SHARED_UART_ENABLED
	select SERIAL
    select UART_ASYNC_API
    select PINCTRL

if SHARED_UART

config SHARED_UART_INIT_PRIORITY
    int "Shared UART sys init priority"
    default 50

endif

module = SHARED_UART
module-str = Shared UART Support
module-help = Sets log level for shared UART support
source "subsys/logging/Kconfig.template.log_config"
```

## drivers/stepper/Kconfig
```kconfig
if STEPPER

comment "Stepper Drivers"

# zephyr-keep-sorted-start
rsource "adi_tmc/Kconfig"
# zephyr-keep-sorted-stop

endif
```

## drivers/stepper/adi_tmc/Kconfig
```kconfig
if STEPPER_ADI_TMC

config STEPPER_ADI_TMC_UART
	bool "Use Trinamic Stepper Controller with UART"
	depends on STEPPER_ADI_TMC
	select UART
	help
	  A Trinamic Stepper Controller with UART is enabled

comment "Trinamic Stepper Drivers"

rsource "Kconfig.tmc22xx_pokibot"

endif # STEPPER_ADI_TMC
```

## drivers/stepper/adi_tmc/Kconfig.tmc22xx_pokibot
```kconfig
config STEPPER_ADI_TMC2209_POKIBOT
	bool "Activate trinamic tmc2209 pokibot flavored stepper driver"
	depends on DT_HAS_ADI_TMC2209_POKIBOT_ENABLED
	select STEPPER_ADI_TMC_UART
	default y
	help
	  Stepper driver for TMC2209.
```

## drivers/uart_bus/Kconfig
```kconfig
menuconfig UART_BUS
	bool "UART Bus line support"
	default y
	depends on DT_HAS_ZEPHYR_UART_BUS_ENABLED
	select SERIAL
    select UART_ASYNC_API

if UART_BUS

config UART_BUS_INIT_PRIORITY
    int "UART Bus sys init priority"
    default 50

endif

module = UART_BUS
module-str = UART bus Support
module-help = Sets log level for UART bus support
source "subsys/logging/Kconfig.template.log_config"
```

## dts/bindings/lidar/pokibot,msmlidar,.yaml
```yaml
description: |
  msmlidar lidar driver

compatible: "pokibot,msmlidar"

include: base.yaml

properties:
  id:
    type: int
    required: true
```

## dts/bindings/lidar/zephyr,FHL-LD19.yaml
```yaml
description: |
  FHL-LD19 lidar driver
  Example definition in devicetree:

    lidar {
        compatible = "zephyr,FHL-LD19";
    };

compatible: "zephyr,FHL-LD19"

include: base.yaml
```

## dts/bindings/lidar/zephyr,fhl-ld19.yaml
```yaml
description: |
  FHL-LD19 lidar driver
  Example definition in devicetree:

    lidar {
        compatible = "zephyr,fhl-ld19";
    };

compatible: "zephyr,fhl-ld19"

include: base.yaml
```

## dts/bindings/pokmac/pokibot,pokmac.yaml
```yaml
description: |
  Pokmac driver
  Has to be on a uart node

compatible: "pokibot,pokmac"

include: uart-device.yaml
```

## dts/bindings/pokmac/zephyr,pokmac.yaml
```yaml
description: |
  Pokmac driver
  Has to be on a uart node

compatible: "zephyr,pokmac"

include: uart-device.yaml
```

## dts/bindings/pokstepper/adi,tmc2209-pokibot.yaml
```yaml
description: |
  Analog Devices TMC2209 Stepper Motor Controller

  Example:

    &uart_bus0 {
        compatible = "zephyr,uart_bus";
        status = "okay";

        tmc2209_pokibot: tmc2209_pokibot {
            compatible = "adi,tmc2209_pokibot";
            status = "okay";
            address = <0>;

            /* common stepper controller settings */
            micro-step-res = <256>;
            /* tmc specific */
            ihold = <15>;
            irun = <31>;
            iholddelay = <10>;
        };
    };

compatible: "adi,tmc2209-pokibot"

include:
  - name: uart-bus-device.yaml

properties:
  en-gpios:
    type: phandle-array
    description: |
      Enable pin power part | optional, activated by default

  nstdby-gpios:
    type: phandle-array
    description: |
      Enable pin logic part | optional, activated by default

  micro-step-res:
    type: int
    default: 256
    enum:
      - 1
      - 2
      - 4
      - 8
      - 16
      - 32
      - 64
      - 128
      - 256
    description: |
      micro-step resolution to be set while initializing the device driver.

  ihold:
    required: true
    type: int
    default: 15
    description: |
      Hold current in % of run current (0-100)
      Standstill current (0=1/32…31=32/32)
      In combination with StealthChop mode, setting IHOLD=0 allows to choose freewheeling or coil
      short circuit for motor stand still

  irun:
    type: int
    default: 31
    description: |
      Motor run current (0=1/32…31=32/32)
      Hint: Choose sense resistors in a way, that normal
      IRUN is 16 to 31 for best microstep performance.

  iholddelay:
    type: int
    default: 8
    description: |
      Controls the number of clock cycles for motor power down after a motion as soon as TZEROWAIT
      has expired. The smooth transition avoids a motor jerk upon power down.
      0: instant power down
      1..15: Delay per current reduction step in multiple of 2^18 clocks

  reverse-shaft:
    type: boolean

  step-gpios:
    type: phandle-array
    description: |
      The GPIO pins used to send step signals to the stepper motor.

  dir-gpios:
    type: phandle-array
    description: |
      The GPIO pins used to send direction signals to the stepper motor.
      Pin will be driven high for forward direction and low for reverse direction.

  counter:
    type: phandle
    description: Counter used for generating step-accurate pulse signals.

  sg-poll-period-ms:
    type: int
    default: 2
    description: |
      Stall guard sg result polling period

  initial-sg-poll-period-ms:
    type: int
    default: 10
    description: |
      Initial stall guard sg result polling period

  sg-nb-consecutive-trigger:
    type: int
    default: 2
    description: |
      Number of consecutive values under the threshold to consider it a stall
```

## dts/bindings/pokstepper/pokibot,empty-pokstepper.yaml
```yaml
description: Empty pokstepper

compatible: "pokibot,empty-pokstepper"

include: base.yaml
```
