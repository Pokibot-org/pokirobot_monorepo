## dts/bindings/pokstepper/pokibot,mks-pokstepper.yaml
```yaml
description: MKS ServoCAN stepper motor driver

compatible: "pokibot,mks-pokstepper"

include: base.yaml

properties:
  can-device:
    type: phandle
    required: true
    description: Reference to the CAN device (e.g., fdcan1)
    
  motor-id:
    type: int
    required: true
    description: CAN identifier/address for this motor (0x000-0x7FF)
```

## dts/bindings/servomotor/pokibot,empty-servomotor.yaml
```yaml
description: Empty servomotor

compatible: "pokibot,empty-servomotor"

include: base.yaml
```

## dts/bindings/servomotor/pokibot,pwm-servomotor.yaml
```yaml
description: PWM servomotor driver

compatible: "pokibot,pwm-servomotor"

properties:
  pwms:
    required: true
    type: phandle-array
    description: PWM specifier driving the servo motor.

  min-pulse:
    required: true
    type: int
    description: Minimum pulse width (nanoseconds).

  max-pulse:
    required: true
    type: int
    description: Maximum pulse width (nanoseconds).

  min-angle:
    required: true
    type: int
    description: Minimum angle (degrees).

  max-angle:
    required: true
    type: int
    description: Maximum angle (degrees).
```

## dts/bindings/shared_uart/zephyr,shared-uart.yaml
```yaml
description: Master Slave Shared uart
compatible: "zephyr,shared-uart"

include: uart-device.yaml

bus: shared-uart
```

## dts/bindings/uart_bus/uart-bus-device.yaml
```yaml
include: base.yaml

on-bus: uart-bus

properties:
  address:
    type: int
    required: true
```

## dts/bindings/uart_bus/zephyr,uart-bus.yaml
```yaml
description: Master Slave uart bus
compatible: "zephyr,uart-bus"

include: uart-device.yaml

bus: uart-bus
```

## lib/Kconfig
```kconfig
menu "Pokibot libraries"

rsource "poktocol/Kconfig"
rsource "pokutils/Kconfig"
rsource "poktrigo/Kconfig"
endmenu
```

## modules/paho-mqtt-c/Kconfig
```kconfig
#
# Copyright (c) 2019 Manivannan Sadhasivam
#
# SPDX-License-Identifier: Apache-2.0
#

config ZEPHYR_PAHO_MQTT_C_MODULE
	bool

config NATIVE_MQTT
	bool "Native mqtt support using paho mqtt c"
	help
	  This option enable the support for paho mqtt library
```

## subsys/Kconfig
```kconfig
# Subsystem configuration options

# Copyright (c) 2016-2017 Intel Corporation
# Copyright (c) 2021 Nordic Semiconductor
# SPDX-License-Identifier: Apache-2.0

menu "Sub Systems and OS Services"

rsource "mqtt_sim_messager/Kconfig"
rsource "pokuicom/Kconfig"
rsource "poklegscom/Kconfig"

endmenu
```

## subsys/mqtt_sim_messager/Kconfig
```kconfig
menuconfig MQTT_SIM_MESSAGER
	bool "MQTT_SIM_MESSAGER subsystem"
	select NATIVE_MQTT

if MQTT_SIM_MESSAGER
module = MSM
module-str = msm
module-help = Tools used for simulation on the host
source "subsys/logging/Kconfig.template.log_config"

config MSM_DEVICE_NAME
    string "Device name used in msm topics"
    default "pokirobot"

endif
```

## subsys/poklegscom/Kconfig
```kconfig
menuconfig POKLEGSCOM
	bool "POKLEGSCOM subsystem"

if POKLEGSCOM

DT_CHOSEN_POKIBOT_POKLEGSCOM := pokibot,poklegscom
choice POKLEGSCOM_IMPL
	prompt "POKLEGSCOM Implementation"
	default POKLEGSCOM_IMPL_SIMULATED if ARCH_POSIX
	default POKLEGSCOM_IMPL_POKMAC if $(dt_chosen_enabled,$(DT_CHOSEN_POKIBOT_POKLEGSCOM))

config POKLEGSCOM_IMPL_POKMAC
	bool "POKLEGSCOM on hardware implementation"
	select POKTOCOL

config POKLEGSCOM_IMPL_SIMULATED
	bool "Simulated implementation"
	select MQTT_SIM_MESSAGER

endchoice

endif # POKLEGSCOM
```

## subsys/pokuicom/Kconfig
```kconfig
menuconfig POKUICOM
	bool "POKUICOM subsystem"

if POKUICOM

DT_CHOSEN_POKIBOT_POKUICOM := pokibot,pokuicom
choice POKUICOM_IMPL
	prompt "POKUICOM Implementation"
	default POKUICOM_IMPL_SIMULATED if ARCH_POSIX
	default POKUICOM_IMPL_POKMAC if $(dt_chosen_enabled,$(DT_CHOSEN_POKIBOT_POKUICOM))

config POKUICOM_IMPL_POKMAC
	bool "Pokuicom on hardware implementation"
	select POKTOCOL

config POKUICOM_IMPL_SIMULATED
	bool "Simulated implementation"
	select MQTT_SIM_MESSAGER

endchoice

endif # POKUICOM
```

## west.yml
```yaml
# Copyright (c) 2021 Nordic Semiconductor ASA
# SPDX-License-Identifier: Apache-2.0

manifest:
  remotes:
    - name: zephyrproject-rtos
      url-base: https://github.com/zephyrproject-rtos
    - name: pokibot-github
      url-base: https://github.com/Pokibot-org

  projects:
    - name: zephyr
      remote: zephyrproject-rtos
      revision: v4.1.0
      import:
        # By using name-allowlist we can clone only the modules that are
        # strictly needed by the application.
        name-allowlist:
          - cmsis # required by the ARM port
          - cmsis-dsp
          - hal_stm32
          - zcbor
    - name: paho-mqtt-c
      remote: pokibot-github
      repo-path: paho.mqtt.c
      revision: e7abcfc795f622ca38d131bae8165852c4994011
      path: modules/lib/paho-mqtt-c
```
